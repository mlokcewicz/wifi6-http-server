## Kconfig
```kconfig
source "Kconfig.zephyr"

config MYFUNCTION
	bool "Enable my function"
	default n

config MQTT_SAMPLE_PUB_TOPIC
	string "MQTT publish topic"

config MQTT_SAMPLE_SUB_TOPIC
	string "MQTT subscribe topic"

config MQTT_SAMPLE_BROKER_HOSTNAME
	string "MQTT broker hostname"
	default "mqtt.nordicsemi.academy"
```
